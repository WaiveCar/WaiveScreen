/dts-v1/;

/*  Enable the 3-axis accelerometer on the SOM-RK3399v2 Dev Kit
    Enable i2c3 bus and add ST LIS3DH at 0x18 */

/ {
	compatible = "rockchip,rk3399";

	fragment@0 {
		target-path = "/i2c@ff130000";

		__overlay__ {
			status = "okay";

			lis3dh@18 {
				compatible = "st,lis3dh-accel";
				reg = < 0x18 >;
			};
		};
	};
};
